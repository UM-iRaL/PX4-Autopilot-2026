## src/drivers/dynamixel/Kconfig
```kconfig
menuconfig DRIVERS_DYNAMIXEL
    bool "dynamixel"
    default y
    ---help---
        Enable support for dynamixel
```

## src/examples/dynamixel_test/Kconfig
```kconfig
menuconfig EXAMPLES_DYNAMIXEL_TEST
	bool "dynamixel_test"
	default n
	---help---
		Enable support for dynamixel test app
```

## src/modules/dynamixel_test/Kconfig
```kconfig
menuconfig MODULES_DYNAMIXEL_TEST
	bool "dynamixel_test"
	default y
	---help---
		Enable support for dynamixel test app
```

## src/modules/geometric_control/Kconfig
```kconfig
menuconfig MODULES_GEOMETRIC_CONTROL
	bool "geometric_control"
	default n
	---help---
		Enable support for sih

menuconfig USER_GEOMETRIC_CONTROL
	bool "geometric_control running as userspace module"
	default y
	depends on BOARD_PROTECTED && MODULES_GEOMETRIC_CONTROL
	---help---
		Put geometric_control in userspace memory
```
